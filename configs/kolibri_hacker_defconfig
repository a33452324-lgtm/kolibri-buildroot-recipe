## configs/kolibri_hacker_defconfig
```kconfig
# Architecture
BR2_x86_64=y
BR2_TOOLCHAIN_BUILDROOT_GLIBC=y

# Kernel
BR2_LINUX_KERNEL=y
BR2_LINUX_KERNEL_DEFCONFIG="x86_64_defconfig"

# System
BR2_TARGET_GENERIC_HOSTNAME="kolibri-hacker"
BR2_TARGET_GENERIC_ISSUE="Welcome to Kolibri-Hacker OS"
BR2_TARGET_ROOTFS_EXT2=y
BR2_TARGET_ROOTFS_EXT2_SIZE="100M"
BR2_TARGET_ROOTFS_TAR=y

# Core packages (No legacy conflicts)
BR2_PACKAGE_BUSYBOX=y
BR2_PACKAGE_BASH=y
BR2_PACKAGE_NCURSES=y
BR2_PACKAGE_TMUX=y
BR2_PACKAGE_NANO=y

# Basic Network Tools (Removed CURL, WGET, OPENSSH to avoid legacy error)
BR2_PACKAGE_NMAP=y
BR2_PACKAGE_TCPDUMP=y
BR2_PACKAGE_NETCAT_OPENBSD=y
BR2_PACKAGE_IPROUTE2=y

# Utilities
BR2_PACKAGE_HTOP=y
```
